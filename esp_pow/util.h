#define OLED_ADDRESS 0x3C
#define SCREEN_WIDTH 128
#define SCREEN_HEIGHT 64
#define FLAKE_NUM 32
#define FLAKE_MAP 5

#define I01PWM 0
#define I02PWM 1
#define I11PWM 2
#define I12PWM 3

#define I01 23
#define I02 19
#define I11 18
#define I12 5

#define BTNG 32
#define BTN0 33
#define BTN1 25
#define BTN2 26

// https://lang-ship.com/blog/work/esp32-pwm-max/
#define PWM_FREQ 39062.5//78125.0//1736.1//3472.2//1045.0
#define PWM_BIT 11

const char* ssid="esp_pow";
const char* pass="mcbeeringi";
// QR
// WIFI:S:<SSID>;T:<WEP|WPA|無記入>;P:<パスワード>;H:<true|false|無記入>;

const unsigned char PROGMEM esp_logo[]={
	0x00, 0x00, 0x00, 0x00, 0x00, 0x00, 0x00, 0x00, 0x00, 0x00, 0x00, 0x00, 0x00, 0x00, 0x00, 0x00,
	0x00, 0x00, 0x00, 0x00, 0x00, 0x00, 0x00, 0x00, 0x00, 0x00, 0x00, 0x00, 0x00, 0x00, 0x00, 0x00,
	0x00, 0x00, 0x00, 0x00, 0x00, 0x00, 0x00, 0x00, 0x00, 0x00, 0x00, 0x00, 0x00, 0x00, 0x00, 0x00,
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	0x00, 0x00, 0x00, 0x00, 0x00, 0x00, 0x00, 0x00, 0x00, 0x00, 0x00, 0x00, 0x00, 0x00, 0x00, 0x00
};
const unsigned char PROGMEM logo_bmp[]={
	0x00, 0x00, 0x00, 0x00, 0x00, 0x00, 0x00, 0x00, 0x00, 0x00, 0x00, 0x00, 0x00, 0x00, 0x00, 0x00, 
  0x00, 0x00, 0x00, 0x00, 0x00, 0x00, 0x00, 0x00, 0x00, 0x00, 0x00, 0x00, 0x00, 0x00, 0x00, 0x00, 
  0x00, 0x00, 0x00, 0x00, 0x00, 0x00, 0x00, 0x00, 0x00, 0x00, 0x00, 0x00, 0x00, 0x00, 0x00, 0x00, 
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  0x00, 0x00, 0x00, 0x00, 0x00, 0x00, 0x00, 0x00, 0x00, 0x00, 0x00, 0x00, 0x00, 0x00, 0x00, 0x00
};
const unsigned char PROGMEM logo_txt[]={
  0x00, 0x00, 0x00, 0x00, 0x00, 0x00, 0x00, 0x00, 0x00, 0x00, 0x00, 0x00, 0x00, 0x00, 0x00, 0x00, 
  0x00, 0x00, 0x00, 0x00, 0x00, 0x00, 0x00, 0x00, 0x00, 0x00, 0x00, 0x00, 0x00, 0x00, 0x00, 0x00, 
  0x00, 0x00, 0x00, 0x00, 0x00, 0x00, 0x00, 0x00, 0x00, 0x00, 0x00, 0x00, 0x00, 0x00, 0x00, 0x00, 
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  0x00, 0x00, 0x00, 0x00, 0x00, 0x00, 0x00, 0x00, 0x00, 0x00, 0x00, 0x00, 0x00, 0x00, 0x00, 0x00
};
const unsigned char cphpa [] PROGMEM = {
  0x00, 0x00, 0x60, 0x00, 0x90, 0xf0, 0x93, 0xfc, 0x67, 0x0c, 0x0e, 0x00, 0x0c, 0x00, 0x0c, 0x00, 
  0x0c, 0x00, 0x0c, 0x00, 0x0c, 0x00, 0x0e, 0x04, 0x07, 0x0e, 0x03, 0xfc, 0x00, 0xf0, 0x00, 0x00, 
  0x00, 0x00, 0x00, 0x00, 0x00, 0x00, 0x78, 0x40, 0x48, 0xc0, 0x4d, 0x80, 0x49, 0x00, 0x6b, 0x00, 
  0x3e, 0x00, 0x05, 0xe0, 0x0d, 0x20, 0x19, 0x20, 0x11, 0x20, 0x31, 0x60, 0x21, 0xc0, 0x00, 0x00, 
  0x00, 0x00, 0x00, 0x00, 0x63, 0xc0, 0x63, 0xe0, 0x63, 0x60, 0x73, 0x34, 0x7f, 0x3e, 0x6f, 0xfb, 
  0x6f, 0xfb, 0x6f, 0x07, 0x6f, 0x1f, 0x6f, 0x1b, 0x6f, 0x1b, 0x6f, 0x1f, 0x6f, 0x0f, 0x00, 0x00
};
const unsigned char PROGMEM flake_bmp[FLAKE_MAP][3]={
	//must be 3x3 align to top_left
	{0xa0, 0x40, 0xa0},
	{0x40, 0xe0, 0x40},
	{0x80, 0x40, 0x00},
	{0x40, 0x80, 0x00},
	{0x80, 0x00, 0x00}
};
static const unsigned int flake_s[FLAKE_MAP]={3,3,2,2,1};
static const char html[] PROGMEM=R"rawliteral(
<!DOCTYPE html>
<html lang="en" dir="ltr">
<head>
	<meta charset="utf-8">
	<meta name="viewport" content="width=device-width,initial-scale=1">
	<title>esp_pow</title>
</head>
<body>
	<style>
		:root,input{background-color:#222;color:#fff;font-family:monospace;}
		input{vertical-align:middle;}input[type=range]{width:100%;max-width:640px;margin:0;box-sizing:border-box;}
		pre{white-space:pre-wrap;}#wrap{display:none;}label{background-color:#8888;padding:12px;border-radius:12px;}
	</style>
	<datalist id="memori">
		<option value="-100"></option><option value="-75"></option><option value="-50"></option><option value="-25"></option>
		<option value="0"></option><option value="25"></option><option value="50"></option><option value="75"></option><option value="100"></option>
	</datalist>

	<h1>esp_pow</h1>
	<div id="wrap">
		<h2>DISP</h2>
		<form id="disp">
			<label><input type="radio" name="mode" value="0" checked>BME280</label>
			<label><input type="radio" name="mode" value="1">PWM</label>
		</form>
		<h2>PWM</h2>
		<form id="pwm">
			<label><input type="radio" name="mode" value="0" checked>±</label>
			<label><input type="radio" name="mode" value="1">+</label>
			<label><input type="radio" name="mode" value="2">-</label>
			<label><button type="button" id="eb">= 0 =</button></label>
		</form><br>
		<input type="range" id="pwm0" step="0.001" list="memori"><br><br>
		<input type="range" id="pwm1" step="0.001" list="memori"><br><br>
	</div>
	<pre id="log">Connecting…</pre>

	<script>
		'use strict';
		let ws,recieved={},timer=0;
		const ws_init=()=>{
			console.log('ws_init');
			ws=new WebSocket(`ws://${window.location.hostname}/ws`);
			ws.onopen=e=>{
				console.log(log.textContent='Opened :)');
			};
			ws.onclose=e=>{
				console.log(log.textContent='Closed :(');
				wrap.style.display='';
				setTimeout(ws_init,2000);
			};
			ws.onmessage=e=>{
				Object.assign(recieved,JSON.parse(e.data));
				log.textContent=JSON.stringify(recieved,null,'\t');
				if(recieved.purpose=='init'){
					disp.mode.value=recieved.disp;
					pwm.mode.value=0;pwm.onchange();
					[pwm0.value,pwm1.value]=[recieved.pwm0,recieved.pwm1].map(x=>x*100/recieved.max);
					wrap.style.display='unset';
				}
			};
			ws.onerror=console.log;
		},
		disp_send=()=>{
			if(!wrap.style.display)return;
			ws.send(`DISP${disp.mode.value}`);
		},
		pwm_send=(x,i)=>{
			if(!wrap.style.display)return;
			ws.send(`PWM${i}${String(Math.round((x.value/100+1)*recieved.max)).padStart(recieved.zpad2,'0')}`);
		};

		disp.onchange=disp_send;
		pwm.onchange=()=>[pwm0,pwm1].forEach((x,i)=>{
			const tmp=x.value;
			[x.min,x.max]=[[-100,100],[0,100],[-100,0]][pwm.mode.value];
			if(x.value!=tmp)pwm_send(x,i);
		});
		eb.onclick=()=>[pwm0,pwm1].forEach((x,i)=>{x.value=0;pwm_send(x,i);});
		[pwm0,pwm1].forEach((x,i)=>{
			x.oninput=()=>{if(timer)return;pwm_send(x,i);timer=setTimeout(()=>timer=0,50);};
			x.onchange=()=>{clearTimeout(timer);timer=0;pwm_send(x,i);};
		});
		window.onload=ws_init;
		//wrap.style.display='unset';
	</script>
</body>
</html>
)rawliteral";
